
/*
使用说明
请根据自己的平台实现以下函数
1.实现SPI的读取接口 ，如下面的 HAL_SPI_Transmit
2.实现spi片选，如下面的 cs_low() 、 cs_high()
3.实现微秒延时函数  delay_us(),保证 delay_us(1)执行时间不小于1us
*/



static uint8_t s_fm_spi_buff[1024];
#define FIN_PCL_NORMAL_HEAD_LEN                             5



/* Table of CRC values for low-order byte */
static const unsigned char auchCRCLo[] = 
{
    0x00, 0xC0, 0xC1, 0x01, 0xC3, 0x03, 0x02, 0xC2, 0xC6, 0x06,
    0x07, 0xC7, 0x05, 0xC5, 0xC4, 0x04, 0xCC, 0x0C, 0x0D, 0xCD,
    0x0F, 0xCF, 0xCE, 0x0E, 0x0A, 0xCA, 0xCB, 0x0B, 0xC9, 0x09,
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    0x43, 0x83, 0x41, 0x81, 0x80, 0x40
} ;


/*******************************************
@brief  crc8 generation function
@param  *puchMsg crc校验的数组（u8类型、单字节）
@param  usDataLen 数组长度
@return crc校验结果（unsigned char）
*******************************************/
static uint8_t crc8_cal(const uint8_t *puchMsg, uint32_t usDataLen)
{
    unsigned char uchCRCLo = 0xFF ; /* low CRC byte initialized */
    unsigned uIndex ; /* will index into CRC lookup*/
    /* table */
    while (usDataLen--) /* pass through message buffer */
    {
        uIndex   = uchCRCLo ^ *puchMsg++ ; /* calculate the CRC */
        uchCRCLo = auchCRCLo[uIndex] ;
    }
    return uchCRCLo;  
}




/*** 
 * @bridf: 读模组数据
 * @param func_code - 功能码
 * @param addr - 起始地址
 * @param len - 读取的字节数
 * @return NULL:失败;
 *         非NULL:有效数据的buffer，其中第一个字节是status,第二个字节开始是有效数据
 */
static uint8_t *module_ex_read(uint8_t func_code, uint16_t addr, uint16_t len)
{
    uint16_t total;
    uint8_t *ptr = NULL;

    s_fm_spi_buff[0] = func_code | (1<<7);
    *(uint16_t*)(s_fm_spi_buff + 1) = addr;
    *(uint16_t*)(s_fm_spi_buff + 3) = len;

    if(len > (sizeof(s_fm_spi_buff) - 10))
    {
        return NULL;
    }

    cs_low();
    delay_us(8);

    HAL_SPI_Transmit(s_fm_spi, s_fm_spi_buff, FIN_PCL_NORMAL_HEAD_LEN, 500);
    delay_us(25);
    HAL_SPI_Receive(s_fm_spi, s_fm_spi_buff+FIN_PCL_NORMAL_HEAD_LEN, len + 2, 500);

    delay_us(25);
    cs_high();  
    delay_us(8);

    total = FIN_PCL_NORMAL_HEAD_LEN + 1 + len + 1;
    if(crc8_cal(s_fm_spi_buff, total))
    {
        printf("crc fail \r\n");
    }
    else
    {
        ptr = s_fm_spi_buff + FIN_PCL_NORMAL_HEAD_LEN;
    }

    return ptr;

}


/*** 
 * @bridf: 写模组
 * @param func_code - 功能码
 * @param addr - 起始地址
 * @param len - 写入的字节数
 * @param *pdata  - 待写入的数据
 * @return 
 */
static void module_ex_write(uint8_t func_code, uint16_t addr, uint16_t len, int8_t *pdata)
{
    uint16_t total;
    uint8_t crc, *ptr = NULL;

    total = FIN_PCL_NORMAL_HEAD_LEN + len + 1;

    if(total > sizeof(s_fm_spi_buff))
    {
        return;
    }

    s_fm_spi_buff[0] = func_code & (~(1<<7));
    *(uint16_t*)(s_fm_spi_buff + 1) = addr;
    *(uint16_t*)(s_fm_spi_buff + 3) = len;    

    memcpy(s_fm_spi_buff + FIN_PCL_NORMAL_HEAD_LEN, pdata, len);

    crc = crc8_cal(s_fm_spi_buff, total - 1);
    s_fm_spi_buff[total-1] = crc;

    cs_low();  //根据模组的译码片选地址来配置CS引脚电平
    delay_us(8);
    
    //根据平台，实现读取SPI的函数接口
    HAL_SPI_Transmit(s_fm_spi, s_fm_spi_buff, total, 500);

    delay_us(25);
    cs_high();  //将所有CS引脚电平拉高
    delay_us(8);

}


/*** 
 * @bridf: 参考代码
 */
void module_ex_test(void)
{
    uint8_t temp, *pdata;

    //重标定，根据需要执行
    temp = 1;
    module_ex_write(0x79, 3, 1, &temp);
    delay_us(1000);


    //读取一部分虚拟网格区域的力值
    pdata = module_ex_read(0x7b, 1038, 3*9);
    if(pdata)
    {
        //pdata[0]是返回的状态，pdata[1]~pdata[27]就是读到的一部分虚拟网格区域的力值
        printf("read sucess\r\n");
    }
    else
    {
        printf("read error\r\n");
    }
}


